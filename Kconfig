## Kconfig
```kconfig
DT_COMPAT_ZMK_BEHAVIOR_REPORT := zmk,behavior-report

config ZMK_BEHAVIOR_REPORT
    bool
    default $(dt_compat_enabled,$(DT_COMPAT_ZMK_BEHAVIOR_REPORT))
    depends on DT_HAS_ZMK_BEHAVIOR_REPORT_ENABLED
    select ZMK_SEND_STRING
```

## west.yml
```yaml
manifest:
  remotes:
    - name: nxtkb
      url-base: https://github.com/nxtkb
  projects:
    - name: zmk-behavior-send-string
      remote: nxtkb
      revision: 96fad37f0dc9bfcc32b8fd6c51233e5285b36250
```
